/ {
	imx586@1a {
		compatible = "sony,imx586";
		reg = <0x1a>;
		clocks = <&clk IMX8QM_CLK_DC_0_VIDEO_POST>; /* example */
		clock-names = "xclk";
		clock-frequency = <37125000>;

		reset-gpios = <&lsio_gpio3 1 GPIO_ACTIVE_HIGH>; /* adjust */

		/* Connect to MIPI CSI0, four-lane */
		port {
			imx586_mipi0_ep: endpoint {
				remote-endpoint = <&mipi_csi0_ep>;
				data-lanes = <1 2 3 4>;
				clock-lanes = <0>;
				link-frequencies = /bits/ 64 <445500000>;
		};
		};
	};
};
