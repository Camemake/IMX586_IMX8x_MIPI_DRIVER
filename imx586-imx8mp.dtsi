/ {
	imx586@1a {
		compatible = "sony,imx586";
		reg = <0x1a>;
		clocks = <&clk IMX8MP_CLK_CLKO1>;
		clock-names = "xclk";
		clock-frequency = <37125000>;

		reset-gpios = <&gpio1 5 GPIO_ACTIVE_HIGH>; /* adjust */

		/* CSI MUX: use MIPI CSI 0 four lanes */
		port {
			imx586_ep: endpoint {
				remote-endpoint = <&mipi_csi0_ep>;
				data-lanes = <1 2 3 4>;
				clock-lanes = <0>;
				link-frequencies = /bits/ 64 <445500000>;
		};
		};
	};
};
